## firmware/main/Kconfig.projbuild
```kconfig
menu "HarnessLink hardware"
config HL_MIC_BCLK
    int "Microphone SCK / BCLK GPIO"
    default 4
config HL_MIC_WS
    int "Microphone WS GPIO"
    default 5
config HL_MIC_DATA
    int "Microphone SD GPIO"
    default 6
config HL_MIC_RIGHT
    bool "Use microphone right channel (L/R tied high)"
    default n
config HL_MIC_SHIFT
    int "Right shift 32-bit microphone samples to PCM16"
    range 8 24
    default 16
config HL_AMP_BCLK
    int "Amplifier BCLK GPIO"
    default 15
config HL_AMP_WS
    int "Amplifier LRC GPIO"
    default 16
config HL_AMP_DATA
    int "Amplifier DIN GPIO"
    default 17
config HL_LED_GPIO
    int "Onboard WS2812 GPIO (verify board revision)"
    default 48
config HL_BOOT_GPIO
    int "Push-to-talk BOOT GPIO"
    default 0
endmenu
```

## firmware/sdkconfig.defaults
```kconfig
CONFIG_IDF_TARGET="esp32s3"
CONFIG_ESPTOOLPY_FLASHSIZE_4MB=y
CONFIG_ESPTOOLPY_FLASHMODE_DIO=y
CONFIG_ESP_CONSOLE_USB_SERIAL_JTAG=y
CONFIG_ESP_CONSOLE_SECONDARY_NONE=y
CONFIG_PARTITION_TABLE_SINGLE_APP_LARGE=y
CONFIG_ESP_MAIN_TASK_STACK_SIZE=16384
CONFIG_FREERTOS_HZ=1000
CONFIG_LOG_DEFAULT_LEVEL_WARN=y
CONFIG_ESP_WIFI_STA_DISCONNECTED_PM_ENABLE=n
```
